## components/comp_dht/Kconfig.projbuild
```kconfig
menu "DHT_PARAMETERS"
	config DHT_PIN
		int "Seleccion del pin de conexion de dht"
		default 13
		help
			Se debe especificar un número de pin en que se va a conectar
			la señal del dht.
		
	config SENSOR_TYPE
		int "Seleccion del tipo de sensor DH21"
		default 1
		help
			Se trata del tipo de sensor que se posee (escoja los valores: 0, 1 o 2)
			0 DHT_TYPE_DHT11
			1 DHT_TYPE_AM2301
			2 DHT_TYPE_SI7021       
endmenu
```

## components/comp_pzem/Kconfig.projbuild
```kconfig
menu "PZEM_PARAMETERS"
	config PZEM_RXD
		int "Pin de conexión tipo Rx"
		default 16
		help
			Se debe especificar el pin correspondiente a la transmisión Rx
			del sensor PZEM.
		
	config PZEM_TXD
		int "Pin de conexión tipo Tx"
		default 17
		help
			Se debe especificar el pin correspondiente a la transmisión Tx
			del sensor PZEM.
			
	config PZEM_BAUD_RATE
		int "Baud rate"
		default 9600
		help
			Se debe especificar la velocidad de la tasa de transmisión de datos
			Use cualquiera de las siguientes opciones
			2400
			4800
			9600
			14400
			19200
			28800
			115200
	config PZEM_UART_PORT
		int "Numero de puerto UART"
		default 2
		help
			Seleccione el puerto UART al que desea conectar su sensor
			las opciones son:
			0
			1
			2
	
endmenu
```
